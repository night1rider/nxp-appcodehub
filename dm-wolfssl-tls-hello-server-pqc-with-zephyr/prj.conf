## CMakeLists.txt
```
cmake_minimum_required(VERSION 3.20.0)
find_package(Zephyr REQUIRED HINTS $ENV{ZEPHYR_BASE})
project(wolfssl-tls-hello-server)

# Check if the symbolic link __repo__ exists
if(NOT EXISTS "${CMAKE_SOURCE_DIR}/__repo__")
    # Create a symbolic link from __repo__ to the ZEPHYR_BASE environment variable
    execute_process(
        COMMAND ${CMAKE_COMMAND} -E create_symlink $ENV{ZEPHYR_BASE}/.. ${CMAKE_SOURCE_DIR}/__repo__
        COMMAND_ECHO STDOUT
    )
endif()

target_sources(app PRIVATE src/main.c)
target_sources(app PRIVATE __repo__/modules/crypto/wolfssl/wolfcrypt/benchmark/benchmark.c)
target_include_directories(app PRIVATE src)

add_definitions(-DWOLFSSL_USER_SETTINGS)
```

## prj.conf
```kconfig
CONFIG_UART_CONSOLE=y

# Clock for time()
CONFIG_CLOCK_CONTROL=y
CONFIG_POSIX_CLOCK=y

# Log settings. Using immediate mode to not drop bursty logs
CONFIG_LOG=y
CONFIG_LOG_PRINTK=n

CONFIG_MAIN_STACK_SIZE=32768

CONFIG_ASSERT=y

# POSIX Settings
CONFIG_POSIX_API=y
CONFIG_NET_SOCKETS_POSIX_NAMES=y

# Network settings
CONFIG_NETWORKING=y
CONFIG_NET_CONFIG_SETTINGS=y
CONFIG_NET_L2_ETHERNET=y
CONFIG_NET_IPV4=y
CONFIG_NET_DHCPV4=y
CONFIG_NET_SOCKETS=y
CONFIG_NET_TCP=y 
CONFIG_DNS_RESOLVER=y
# TLS configuration

CONFIG_WOLFSSL=y
CONFIG_WOLFSSL_BUILTIN=y
CONFIG_WOLFSSL_DEBUG=y
CONFIG_WOLFSSL_TLS_VERSION_1_2=y
CONFIG_WOLFSSL_TLS_VERSION_1_3=y

# CONFIG_NET_BUF_DATA_SIZE=512
CONFIG_NET_BUF_DATA_SIZE=1536

CONFIG_ENTROPY_GENERATOR=y
CONFIG_TEST_RANDOM_GENERATOR=y

#ETHERNET
CONFIG_ETH_NXP_ENET_QOS=y
CONFIG_ETH_NXP_ENET_QOS_MAC=y

# Needed for threading 
CONFIG_PTHREAD_IPC=y

# print floats in benchmarks
CONFIG_FPU=y
CONFIG_CBPRINTF_FP_SUPPORT=y

# 120k
# CONFIG_HEAP_MEM_POOL_SIZE=122880

# 42k
# CONFIG_MAIN_STACK_SIZE=43008
CONFIG_WOLFSSL_SETTINGS_FILE="user_settings.h"
```

## src/main.c
```c
/* main.c
 *
 * Copyright (C) 2006-2024 wolfSSL Inc.
 *
 * This file is part of wolfSSL.
 *
 * wolfSSL is free software; you can redistribute it and/or modify
 * it under the terms of the GNU General Public License as published by
 * the Free Software Foundation; either version 2 of the License, or
 * (at your option) any later version.
 *
 * wolfSSL is distributed in the hope that it will be useful,
 * but WITHOUT ANY WARRANTY; without even the implied warranty of
 * MERCHANTABILITY or FITNESS FOR A PARTICULAR PURPOSE.  See the
 * GNU General Public License for more details.
 *
 * You should have received a copy of the GNU General Public License
 * along with this program; if not, write to the Free Software
 * Foundation, Inc., 51 Franklin Street, Fifth Floor, Boston, MA 02110-1335, USA
 */

/* wolfSSL Includes Start */
#include "user_settings.h"      /* For wolfSSL Zephyr configuration */
#include <wolfssl/wolfcrypt/settings.h>
#include <wolfssl/ssl.h>        /* Basic functionality for TLS */
#include <wolfssl/certs_test.h> /* Needed for Cert Buffers */
#include <wolfssl/wolfcrypt/hash.h>
#include <wolfcrypt/benchmark/benchmark.h>
/* wolfSSL Includes End */

/* Standard Packages Start */
#include <stdio.h>
#include <time.h>
/* Standard Packages End */

/* Zephyr Includes Start */
#include <zephyr/kernel.h>
#include <zephyr/drivers/gpio.h>
#include <zephyr/net/net_if.h>
#include <zephyr/net/dhcpv4.h>
#include <zephyr/net/net_core.h>
#include <zephyr/net/net_context.h>
#include <zephyr/net/net_mgmt.h>
#include <zephyr/net/net_config.h>
#include <zephyr/net/net_ip.h>
/* Zephyr Includes End */


#include "pem_data_mldsa44.h"

/* Program Defines Start */

#define DEFAULT_PORT 11111  /* Define the port we want to use for the network */
#define BUFFER_SIZE  256  /* Define the buffer size for file transfer */

/* Use DHCP auto IP assignment or static assignment */
#undef  DHCP_ON
#define DHCP_ON 0   /* Set to true (1) if you want auto assignment IP, */
                    /* set false (0) for statically defined. */
                    /* Make sure to avoid IP conflicts on the network you */
                    /* assign this to, check the defaults before using. */
                    /* If unsure, leave DHCP_ON set to 1 */
 
#if DHCP_ON == 0
/* Define Static IP, Gateway, and Netmask */
    #define STATIC_IPV4_ADDR  "1.1.1.5"
    #define STATIC_IPV4_GATEWAY "1.1.1.1"
    #define STATIC_IPV4_NETMASK "255.0.0.0"
#endif

/* Set the TLS Version. Currently only 2 or 3 is available for this */
/* application, defaults to TLSv3 */
#undef TLS_VERSION
#define TLS_VERSION 3

/* This sets up the correct function for the application via macros */
#undef TLS_METHOD
#if TLS_VERSION == 3
    #define TLS_METHOD wolfTLSv1_3_server_method()
#elif TLS_VERSION == 2
    #define TLS_METHOD wolfTLSv1_2_server_method()
#else 
    #define TLS_METHOD wolfTLSv1_3_server_method()
#endif

/* Set up the network using the Zephyr network stack */
int startNetwork() {

    struct net_if *iface = net_if_get_default();
    char buf[NET_IPV4_ADDR_LEN];

    #if DHCP_ON == 0
        struct in_addr addr, netmask, gw;
    #endif

    if (!(iface)) { /* See if a network interface (ethernet) is available */
        printf("No network interface determined");
        return 1;
    }

    if (net_if_flag_is_set(iface, NET_IF_DORMANT)) {
        printf("Waiting on network interface to be available");
        while(!net_if_is_up(iface)){
            k_sleep(K_MSEC(100));
        }
    }

    #if DHCP_ON == 1
        printf("\nStarting DHCP to obtain IP address\n");
        net_dhcpv4_start(iface);
        (void)net_mgmt_event_wait_on_iface(iface, NET_EVENT_IPV4_DHCP_BOUND, \
                                            NULL, NULL, NULL, K_FOREVER);
    #elif DHCP_ON == 0
        /* Static IP Configuration */
        if (net_addr_pton(AF_INET, STATIC_IPV4_ADDR, &addr) < 0 ||
            net_addr_pton(AF_INET, STATIC_IPV4_NETMASK, &netmask) < 0 ||
            net_addr_pton(AF_INET, STATIC_IPV4_GATEWAY, &gw) < 0) {
            printf("Invalid IP address settings.\n");
            return -1;
        }
        net_if_ipv4_set_netmask_by_addr(iface, &addr, &netmask);
        net_if_ipv4_set_gw(iface, &gw);
        net_if_ipv4_addr_add(iface, &addr, NET_ADDR_MANUAL, 0);

    #else
        #error "Please set DHCP_ON to true (1) or false (0), if unsure set to true (1)"
    #endif

    /* Display IP address that was assigned when done */
    printf("IP Address is: %s\n", net_addr_ntop(AF_INET, \
                    &iface->config.ip.ipv4->unicast[0].ipv4.address.in_addr, \
                    buf, sizeof(buf)));

    return 0;
}

int runWolfcryptBenchmark(void)
{
    int ret = 0;

    ret = benchmark_test(NULL);
    printf("Benchmark Test returned %d.\n", ret);

    return ret;
}

/* Return 1 if the artifacts are in NVRAM, 0 otherwise */
static int artifacts_are_in_nvram() {
    /* TODO: Implement this. */
    return 0;
}

/* Append the data to the certificate or key in NVRAM. Return 0 on success. */
static int write_artifact_to_nvram(char *artifact, char *data, int size) {
    /* TODO: Implement this. */
    return 0;
}

static int receive_artifact(WOLFSSL* ssl, char *artifact)
{
    uint32_t artifact_size_network;
    uint32_t artifact_size;
    unsigned char buffer[BUFFER_SIZE];
    int bytes_received;
    uint32_t total_received = 0;
    int ret = 0;

    if ((ret = wolfSSL_read(ssl, &artifact_size_network, sizeof(artifact_size_network))) != sizeof(artifact_size_network)) {
        fprintf(stderr, "ERROR: Failed to receive size of  %s\n", artifact);
        return -1;
    }

    artifact_size = ntohl(artifact_size_network);
    printf("Receiving %s (size: %u bytes)\n", artifact, artifact_size);

    while (total_received < artifact_size) {
        uint32_t bytes_to_read = (artifact_size - total_received > BUFFER_SIZE) ? 
                                 BUFFER_SIZE : (artifact_size - total_received);
        
        bytes_received = wolfSSL_read(ssl, buffer, bytes_to_read);
        if (bytes_received <= 0) {
            fprintf(stderr, "ERROR: Failed to receive data for %s\n", artifact);
            return -1;
        }

        if (write_artifact_to_nvram(artifact, buffer, bytes_received) != 0) {
            fprintf(stderr, "ERROR: Failed to write %s to NVRAM\n", artifact);
            return -1;
        }

        total_received += bytes_received;
        printf("Received %d bytes (total: %u/%u)\n", bytes_received, total_received, artifact_size);

        if (wolfSSL_write(ssl, "ACK!", 4) != 4) {
            fprintf(stderr, "ERROR: Failed to send ack for %s\n", artifact);
            return -1;
        }
    }

    printf("Successfully received %s (%u bytes)\n", artifact, total_received);
    return 0;
}


/* Initialize Server for a client connection */
int startServer(void) {
    int                sockfd = SOCKET_INVALID;
    int                connd = SOCKET_INVALID;
    struct sockaddr_in servAddr;
    struct sockaddr_in clientAddr;
    socklen_t          size = sizeof(clientAddr);
    int                shutdown = 0;
    int                ret;

    WOLFSSL_CTX* ctx = NULL;
    WOLFSSL*     ssl = NULL;

    wolfSSL_Init();

    /* Create a socket that uses an internet IPv4 address,
     * Sets the socket to be stream based (TCP),
     * 0 means choose the default protocol. */
    if ((sockfd = socket(AF_INET, SOCK_STREAM, 0)) == -1) {
        printf("\nERROR: failed to create the socket\n");
        return 1;
    }

    ctx = wolfSSL_CTX_new(TLS_METHOD);
    if (ctx == NULL) {
        printf("\nERROR: Failed to create WOLFSSL_CTX\n");
        return 1;
    }

    if (wolfSSL_CTX_use_certificate_chain_buffer_format(ctx,
                cert_pem, sizeof(cert_pem),
                WOLFSSL_FILETYPE_PEM) != WOLFSSL_SUCCESS){
        printf("\nERROR: Cannot load server cert buffer\n");
        return 1; 
    }

    if (wolfSSL_CTX_use_PrivateKey_buffer(ctx,
            key_pem, sizeof(key_pem),
            SSL_FILETYPE_PEM) != WOLFSSL_SUCCESS){
        printf("\nERROR: Can't load server private key buffer");
        return 1;
    }

    /* Initialize the server address struct with zeros */
    memset(&servAddr, 0, sizeof(servAddr));

    /* Fill in the server address */
    servAddr.sin_family      = AF_INET;             /* using IPv4      */
    servAddr.sin_port        = htons(DEFAULT_PORT); /* on DEFAULT_PORT */
    servAddr.sin_addr.s_addr = INADDR_ANY;          /* from anywhere   */

    /* Bind the server socket to our port */
    if (bind(sockfd, (struct sockaddr*)&servAddr, sizeof(servAddr)) == -1) {
        printf("\nERROR: failed to bind\n");
        return 1;
    }

    /* Listen for a new connection, allow 5 pending connections */
    if (listen(sockfd, 5) == -1) {
        printf("\nERROR: failed to listen\n");
        return 1;
    } 

    printf("\nServer Started\n");

    /* Continue to accept clients until shutdown is issued */
    while (!shutdown) {
        printf("Waiting for a connection...\n");

        /* Accept client connections */
        if ((connd = accept(sockfd, (struct sockaddr*)&clientAddr, &size))
            == -1) {
            printf("\nERROR: failed to accept the connection\n");
            return 1;
        }

        /* Create a WOLFSSL object */
        if ((ssl = wolfSSL_new(ctx)) == NULL) {
            printf("\nERROR: failed to create WOLFSSL object\n");
            return 1;
        }

        ret = wolfSSL_UseKeyShare(ssl, WOLFSSL_P256_ML_KEM_512);
        if (ret != WOLFSSL_SUCCESS) {
            printf("\nERROR: wolfSSL_UseKeyShare error = %d\n", ret);
            return 1;
        }

        /* Attach wolfSSL to the socket */
        wolfSSL_set_fd(ssl, connd);

        /* Establish TLS connection */
        ret = wolfSSL_accept(ssl);
        if (ret != WOLFSSL_SUCCESS) {
            printf("\nERROR: wolfSSL_accept error = %d\n",
                wolfSSL_get_error(ssl, ret));
            return 1;
        }

        printf("Client connected successfully\n");

        if (receive_artifact(ssl, "certificate") != 0) {
            fprintf(stderr, "ERROR: Failed to receive certificate\n");
            goto cleanup_connection;
        }

        if (receive_artifact(ssl, "key") != 0) {
            fprintf(stderr, "ERROR: Failed to receive key\n");
            goto cleanup_connection;
        }

        printf("Both certificate and key received successfully\n");

cleanup_connection:
        /* Notify the client that the connection is ending */
        wolfSSL_shutdown(ssl);
        printf("Shutdown complete\n");

        /* Cleanup after this connection */
        wolfSSL_free(ssl);      /* Free the wolfSSL object              */
        ssl = NULL;
        close(connd);           /* Close the connection to the client   */
    }

    return 0;
}

int main(void)
{
    printf("\nRunning wolfSSL example from the %s!\n", CONFIG_BOARD);

    /* Start up the network */
    if (startNetwork() != 0){
        printf("Network Initialization via DHCP Failed\n");
        return 1;
    }

    if (runWolfcryptBenchmark() != 0) {
        printf("wolfCrypt Benchmark Failed...Ignoring...\n");
    }

    if (artifacts_are_in_nvram() == 0) {
        printf("Artifacts are NOT in NVRAM\n");
        if (startServer() != 0){
            printf("Server has Failed!");
            return 1;
        }
    } else {
        /* TODO: Do something useful */;
    }

    return 0;
}
```

## src/pem_data_mldsa44.h
```c
#ifndef PEM_DATA_H
#define PEM_DATA_H

/* osp/oqs/mldsa44_entity_cert.pem */
const char cert_pem[] = 
"-----BEGIN CERTIFICATE-----\n"
"MIIRaTCCB9+gAwIBAgIBFTALBglghkgBZQMEAxEwgZYxCzAJBgNVBAYTAkNBMQsw\n"
"CQYDVQQIDAJPTjERMA8GA1UEBwwIV2F0ZXJsb28xFTATBgNVBAoMDHdvbGZTU0wg\n"
"SW5jLjEUMBIGA1UECwwLRW5naW5lZXJpbmcxGTAXBgNVBAMMEFJvb3QgQ2VydGlm\n"
"aWNhdGUxHzAdBgkqhkiG9w0BCQEWEHJvb3RAd29sZnNzbC5jb20wHhcNMjUwMjA0\n"
"MTcyNzM2WhcNMjgwMjA0MTcyNzM2WjCBmjELMAkGA1UEBhMCQ0ExCzAJBgNVBAgM\n"
"Ak9OMREwDwYDVQQHDAhXYXRlcmxvbzEVMBMGA1UECgwMd29sZlNTTCBJbmMuMRQw\n"
"EgYDVQQLDAtFbmdpbmVlcmluZzEbMBkGA1UEAwwSRW50aXR5IENlcnRpZmljYXRl\n"
"MSEwHwYJKoZIhvcNAQkBFhJlbnRpdHlAd29sZnNzbC5jb20wggUyMAsGCWCGSAFl\n"
"AwQDEQOCBSEAYfVqfk3CK9gmLj2JskSasMM7oRIlPn7ZspWgvoTC+0UAZ3Nt1i2E\n"
"IM6ly0Q9K17hEMdUcrX6xTPk3kswlvx/fsO1C7WzwfEy8akQgIwq9oIALN5A2kMp\n"
"L3PbLn9UHxv8VumNJ7C7Z4V/rqVRowOEtT0AM3BuxzOU4Ggkkxt2xC8jtvhXeLIw\n"
"ihZhMK1UCavnpp3QOK2PhZi1n2YrSii76CnRvEJKpN2ITEx8BSRlfo7ODmQufTs0\n"
"DxiVqaNi9HUnGQpNo3USzj2f+pRSeODHyNfRn+otHUguYTGn4V+v88tsS806z8Hi\n"
"vpyQ0C3l+/02G/7C1qOruWZ6go/DeNp/3wTk+EuDR4QPmoRKhIYPK+l8F9Dm3baM\n"
"9+27HDGv3J/p0KPB5bcLF83bG9GGDvtlphCQ9ERhg4cZEUAg3F6UUQAdT//9qTRI\n"
"m2YoW5hSQQvTWjOgUVqADEIlfBJ04Zn7DQ0MD98TgnzGc3x60uBZKC5d3lEfUAWy\n"
"rjadqA6nrFqtbb2r98FT5xcXS157LAwyzre0VE10537f5EojQbuy9gYgdMPF8ZLj\n"
"OlTcDIpvRtCkeIPgAgE/i7LazFJFUt3qQfmSnvjiLUgJ6AigzYnIzvSN7b3bxtrN\n"
"6KtAfeov3dWHlzd7fpgBn/WwNO357NE+Vzn8XtyyuYMammBopxsTRfPvkvQcUsUh\n"
"LRDyQQPr46An8Www7ICDz8DArKT+nCLg6MBr94jR1WshdBjM6bq5Yp2v47SnfkEg\n"
"mlDCx0mp37xI6xzUFOLIMwqeLYf9KgZ+lvbsRi/wcn/O9S7qz8NgynwrAfBpg+jI\n"
"bHBR0aFU6jilFM4rAgJsp59gOYDrNARYbvFKVYYwzDhy41Cf43qEqfj1n0HmHT+M\n"
"TdCucIbvN9xkvVt3En4RjeG3c8dn4NJ+A7KLl7yuMchQEYvmpa/5WnOZf6II3G8X\n"
"TEEOtq6zT2jFFkkbDng6fJOeIKXo/7EZ6qka+CzOiMkNiPverxA58VK3FU00vdT4\n"
"vgssmT6/1ioK0NHQCL4iECqlCdzP3Ixi/l19ttlHsq8gb5p8LSO7FNS2yUwsMPtn\n"
"WMS4sWTGjT4G6wn17RAF/mMXHMijxWhvQGckTMZLYx7y0sSjzEov5WmdhFqMLFN+\n"
"7JxZpAbJ2rpzWWkf6mzWUFY70atUwydiHcagR++MkFIM3LujOI1yvs2uSbKuwN6B\n"
"0etSx8BPGcMriFSGcyeveLDreA1/SuEOW9YnRXxGQBHO/Kwvxs0j53/uUhy7NNIV\n"
"O1zIIj9soCejb6/pL81BM/01qJvBSjkEP5Hl2rp/CoJ/ev2XrtplqML4Yo6Dc68l\n"
"K4YYEs5pnxSIiPHL6EfBqBmauQq8BwGtZAlIZlqspL7Q396NTv91E3v6LXPh8YU6\n"
"rPDIkhZDTYk+j+tR/xvQY7Cv2s5wMLABJVhoT0ErirbBaQWjC8t9iarIdLTbYWa5\n"
"FJ3SHJLDYm5HNECyRncszGuvhT0RmdbS+tozqBgk/12xaV1ax49oBnZt18av3Z+n\n"
"xjM43+JSyjJ13Bf/BxWG1QUDoY0qhxGShLVMclXBhOTPB/UeHB9CwQwdSO3zej7j\n"
"a1DLg35B83Cooh9mtgVK9+/tCi5dtzpApfE/tg9ixVXEWi2hcNH87UTaGmJ4Mr2U\n"
"OOo6rfyo6F1F3fqc0bDZnOK5HUeVWQEHRTebf5hZkEEioIRM0rgK/ssj8sOcuYZq\n"
"TX6svqTpG50fJOwqX1N62atsPsM+dgWRrqOCATowggE2MA8GA1UdEQQIMAaHBH8A\n"
"AAEwHQYDVR0OBBYEFLRKrMD5EOkhnoDDk/YT5aqd1Hn4MIHDBgNVHSMEgbswgbiA\n"
"FNbnmKqw8o4HyMs47KoVx5poCDNloYGcpIGZMIGWMQswCQYDVQQGEwJDQTELMAkG\n"
"A1UECAwCT04xETAPBgNVBAcMCFdhdGVybG9vMRUwEwYDVQQKDAx3b2xmU1NMIElu\n"
"Yy4xFDASBgNVBAsMC0VuZ2luZWVyaW5nMRkwFwYDVQQDDBBSb290IENlcnRpZmlj\n"
"YXRlMR8wHQYJKoZIhvcNAQkBFhByb290QHdvbGZzc2wuY29tggEUMA4GA1UdDwEB\n"
"/wQEAwIHgDAgBgNVHSUBAf8EFjAUBggrBgEFBQcDAQYIKwYBBQUHAwIwDAYDVR0T\n"
"AQH/BAIwADALBglghkgBZQMEAxEDggl1AIvRSQ23mYm+KEpYkN/4go9nkYhMrEls\n"
"1sW3bMWEG9dtx/NImicf5zmRJKw8XR2NLnaRLpVIX2ZHH9QYU3th5itwh6DEqVzh\n"
"jGmKMextlPbR6iksaNA8O5E6kW9t2OBMjsNAKhIVlOVYmbtAq00acABNchtGivVC\n"
"BYBUmS6De668DWMf6WiF2EIZzQV97O9pyZUZF9ZcCs45CeTi+ygT9JQJGtlKqM1J\n"
"RxjNK4YkwrsZzfAKN+aMLSj6kP1DcHsOwuqPV4lF+I4Lh4NP2MUoXdH4QojQrMZ7\n"
"kq7/8qBhZ/RCSAL4La5pnnYTSMG8xguUjgv//srYwcVT2sR2DVjHU8dAFHH4ny0p\n"
"nMPb3OaZcLFu4btHjHpBo/4g40k6CAHOe40LWgpm/p6Npcgh13q1Mn2V9wWWmmao\n"
"e4lVcCjv1mNNU2c+1yYdN4mjQ77zW83Egx7PIUdWVG3tQCxa9GuYpkIijb2LBAN7\n"
"3AyRrTRUv7AfbrqvFBdMYHwmZtM+7CBiy9HnFuVzAU8eOHKeUNnh+oeGSEuGRPrr\n"
"uY4RVIZ22qACUfhiQLriPSRdzhKRPBEMAbbYN7jH2CPXbQqGeNaH8pgIDUAJF8Vl\n"
"g1l7UTS3SEDBcmDeibIRkudaJh/bW1AE7tt7LIEJr6Fars+v94MEDYNw0OZUk0bU\n"
"hVKa56tmHT4q89L/z1ZP3VkRUVjsTbfgmo58dfX8DEj/fxwHjZz9xxT/ojYqBvAO\n"
"zJxkYZlkg05Qe5vN8SPs+j9efnBYBD2Fe/Laj+ti+a7g4/6ShnuEqe0T1bWwL6FN\n"
"SAORvpM255oyKaAfJh+usHG0tN7VZMrXK1tFk1u8HAYZlg1ttyW+NT4DkEyqVCkH\n"
"RYBBUsL3WMsY3Hx7zBqYKDwr0N8vkFyLJreqKu1PM5MwQ26FMtt87eLI+sborW0x\n"
"GhnXjvguuUQgrYMXPp1zp/jZ7qKoHkb91/IAvfFRILexTUOhhaJB6EC877xjwTG1\n"
"fJapKgZmuQWBYb7kRolyxC9mEPDCelubVKwLWtgeKlT7bngcuFuvvJ2ntzUaNb/j\n"
"OPeZWx3/RJ1g7eqtvX5E2tcccCpwVimw/InLp1tvJx5rby5qL3LLpH9KuBKQTVk+\n"
"f6DtsWXxzwrjpVQX37fFShI6YblIqx4zENkwYzvm7XKmiVqpZ6tE3E4b8u6XBoGU\n"
"z0K2RPD10nm+DjZ+wQp3sPPHAlrSFuGDZ7HJgFEztwTvtACXvuFOp/UO6D2K3l6W\n"
"oXeeunDvdGmIP6I+0GMW4NEcW42Ee2HnBC8fMWyyIzM57lfB+KcraEHINSyDSF3n\n"
"odJczTv4ghXTYBBpdYhxkUjzn+pDBht/DExM84IRwBO5Uvps1lIfexvvuAOoXDkI\n"
"vPp4z3QO7qVgJlsNMYAR8wRNed7J0WkjZyKI6Jrxt7XcCicG/MN4q4hZnDnYAJmK\n"
"2fLCGaDrYUzfAOXTUFtxvlj64d70jbHKniELD513Z0M9WUceOHDmD0ep/j5rVi7p\n"
"AQJZ8BWPQFCHp2IK7Gt81m6vIgC1kUNoGJiv9TGGO7JM2z/crSjCH4pRaQWHffYE\n"
"Z8kpK1ZlwlNkyu3t1XxYyls4ndczw19ph9esB8BbU2YG58jz4rXllxttJGfuLW3g\n"
"rpxN59npNhVUHLDeu20QXYtjVeypuhKb/LZ4s/3CXg/WZZlkfWzChwGBU0z1U0Lh\n"
"OBDK1G6qSvS8stbCWfxF45lhy0wWPJjAklAzIu6Bndg6eBgrBCrOt1VJO9GjLVcQ\n"
"tu5RYFMQSoCl9QYt+FMkIYSmrz8tGUVs4yiN3Qp0lEEX7liHv93xaCj2+a8n73jx\n"
"K93EaUwc/SnpkUdGfnNsk0bdE+o9RDYn4gTRM1wUWSkXknVAkEdBPxuXVE+PRhNE\n"
"ifVRnWdBh2/xC4KLI8RMMD4ljbP7LRyD/JhKuYqX0XJxL5HPFmpvpqN14syNbcyE\n"
"mqhoyl2FzPded1TpCQWs1QKdTpiLxWHXg4by6Xs67nyWdOgy4tl2ln/ql8LMrPFX\n"
"fTzWDbSrxwIMmw4AMkFsBGqjsiPja5e4ILMCI0MsKZ9qd/k1fVYqwN7Wt7jTor6D\n"
"SXT9R7pVH+Fs0LafsnU/0sdDZ+tEJiXpc+JwVVjtDr/lZTFGIZYE0l4LIpPrfAqn\n"
"S0GVO0ZzGiS75ncRkvm6OFEGouaf8HMuAiI/RD1JKlLU5o55tcad4WqUppveg2fO\n"
"GVMZJKmhDxYrK0wrIApqvjdpgwT8H250XBTpWvFbqwOyRaFp23mcnT3pjD1F12vT\n"
"d3fiQQrzna+R0OoCe7BP72GGcOOpW6/KETWQdwlI3NMb9zQ0bma3eaNh7g96z5Lx\n"
"TPE9iy9BKVGexVgnQ4IeyFwptyzKW6i+qjDjAM+JobdSE+k1bCg2g/2AC20jDEYC\n"
"rxmE+A/KHsHaRwB+4gMzR5SQMQABjAXGu5oCVwBnTHbfywrcDKOqFzUoZ8rDqROc\n"
"OjRlDM4OjSawgRCT8LYgTT/Qu6K0F58Suqj4JBpLHsO9O6ATSCg5C7mqpp3BwHaS\n"
"aylGz65NFXI2jrj6hkpBPgUbHY9mKcc3+HyU34F1+XcB+BsT1ir0a1IWWodUtawm\n"
"pl75O+fSvRABzuYy0LR+QIWvaevC6GpQ1dT+B2ye0Lw6coh5lmCkNf0a8fI1Ennr\n"
"Ka3Pialce1lTDKnnlun2CRM384Sgcphqhq3KzCzS+7mmY+fW3mzCVsAHV2AgcbFs\n"
"/FTb9L1j4gqRHQfX6BovxqrJKLvIaFnGIdq1LS6/kBQNGsAI4f1rS6ZVANxvkmuD\n"
"woDW9yhBlV8hITXnoBuXjgoFJhTSSEn3zeE817uvcl4DNDI+aDT90HWcwRE5r+Js\n"
"Nv0E/X21KLwsB0BM8ls+spEMAaRg04sEZ+YrVtEp0XFkp218nxL4BV1XFnVM4Rjg\n"
"6hbZOhI/iKAaiKDkjsr8+6Ocugzfs2qrAKcoYUBJRY1pJdxjfcjL0UVW6rWXW/mS\n"
"EqlK9Xik9cSoEuTqxyu9JlBhNaOr4yCzVfeC2EZJoIfD9mrfW+VSzd5ycN5FBdZQ\n"
"s8/iEMATnPaXF3r0wfQmVkSyTzQq/cg5SBWkoPm9E1r/ciGa+i0oo8TW9e+ig6yB\n"
"r94+MV5aNGqlEhYtMz5KWlt/hZKUl5/Gx+kONDw9Vlpudnp/gIiLvsLK3PoNGSc/\n"
"Q1Z2d3yFnqeot9fi5ugXK1lzeoaMkZm5u+n9AAAAAAAAAAAAAAAAAAARIzVC\n"
"-----END CERTIFICATE-----";

/* osp/oqs/mldsa44_entity_key.pem */
const char key_pem[] = 
"-----BEGIN PRIVATE KEY-----\n"
"MIIPOAIBADALBglghkgBZQMEAxEEgg8kBIIPIGH1an5NwivYJi49ibJEmrDDO6ES\n"
"JT5+2bKVoL6EwvtF4Aoxm05WZTMlP+C3GTa8SHi32JEs1g/84UjeLksc4Rqm6QQm\n"
"kiAn8HQ53Qekld30QtZ0wmDvDmPfTTXHJZES9CPeGMScGq7d4HMhyyxcielmvwky\n"
"dFm7FuBotQJ7tFTzIClECMMhE5KQg4ZMGJeRAMaInARIFJFkEQdGCMmJWChGgBBA\n"
"ZEgOQ8IN1DRyUzgGwZYAEpMpkyBhAhlCCqeAS5iFTJCFGDSEFEgMUUByI6dNwsgI\n"
"HERCJEEGIEOCRLIBQriIQTQtVMQEIacMWLRhG7OMCBAEDAMuIRhqScBtSASM0jZN\n"
"GyhqGTJJ4DRRiEJMIcdsiMQxzCBkWhSIoAIkCkFSAUNoxEaJUgYOWUIRipYtkUKR\n"
"yjZFwUJFmaANjCYASBSSwJBQIMRloRJmwCBQ2pSFyJRhQBJkoQhEAgYISzZMFMmQ\n"
"mrgJQgAmyQYKW4gtkAQEAjdwxKZARDgsIBOCGihNDLhgVCCN4BQlWRBwIgFK20CO\n"
"IMRMCyRRo0iEI5MhUyJNGJkBXDaMAjANEUlpGwAqg5gElBAG2pBFWbgwAoeAkgYB\n"
"GBghGAVQhKZphBiMgyABS6BlRIYFmEhxAiVKA6GB4wYqAUSFgpRoCjMByZKR4LYh\n"
"BBUqIjgJWjCGZARJ3DAA0zaRIYEkgkAg2ciMFJNk1LYkA8NpECUuiQCJTDQmXKAw\n"
"W0QgE0Eq2TAqg0CN4MhQGYWNyjZNCKIooxgNUSSRgkZKlDREYyCA07JEIiQy2sZt\n"
"gzgpBAMgAiYwUwKImYRx0DBwQBgC0TApUIBFC5CIEkMtnDBwIyYswDhwWjiCTEAG\n"
"ShhsEDYsSSYKSRgoiUJJG7WI5BgSjDSC3IhkwyJoEadFIkAhjAhRSyRhmbIkBAQi\n"
"ADmBzDBtCSFlCEWGC5RQgwaBUqCJ4CROCDJq0MBhIUBmCbQMnDaADLMlIDCRAyYQ\n"
"CjEp2EIwVIZI0yARgRBCjCIiASeRI0MuGcQIUkZEEwlqWSZAmrAAwCQQxCKKGAWA\n"
"VAIF4iRRJJgQGaNoYRiNgxKAAKQtHEBuG8lkYhhCWiAoAbUgE7lkI7AIYQSGCygg\n"
"C4dQ1KZBXDgAZKRoRBQyGCYACgkswABEoCQsYkQqCYUIIYJpo5iQwLBNC0VMiISN\n"
"EgVJBJdxCqUlgIhwVKc4ZhyPw1twwRik08v8zKTIE7Dbr6qWgwvWTqLWseuviqgE\n"
"XyH+wrvlT38tFaDMOzPa2Hvre2Ik896ZVsVpkYbh8ZDx5xY9jL0Rhilf+AttdeEw\n"
"FQvq3uGlgQAU1234qDHilkvJcLD1nHdANQpH3Y0ARb7kNGQFWAasFOW8fTg3FcR6\n"
"Rya7Ijgtmxn7WfZX1OAQX3Dl4YAvIuusO4dbkNjQDPhWllLBj0WoD/1WXGGIKbq5\n"
"LPsljrYSKFD892YOyqGiQ5u4XkGkcaTuG4MPKdXt268gz4GFa2NalOeyAbihFZ7S\n"
"x8PAX909EcN8VhWIJhRdD6GF1klmTqSLw4wXKsnpULx83xF3HStiBZ77PwHL5CaE\n"
"HhTMGTXg6uCxzZ9RBtND+yTwgC9eQWGlIA08OOAThkkJcYr+JPOvqufzM50La4Ty\n"
"ZHvY2YGqiskwL+Oi2rPy7jZ0nUhDoY+a002VJBSgMSnHuCxcn9fPH9DIqHnM4+mS\n"
"qkdYRDmGjp2sVnZnIaSXjj3QWb//n6e1+2MdL65fJaxj2ijTMzfnygVWVlI2BOwU\n"
"9QIgF5GlHz7vVNBzy4/rXMWhMbL+CknXTMv94dDyBnc9a3WXZ+qA6xOXmFYy2kSh\n"
"ZPiSRfLACP7Sp7Er8ABp3w/wsgLLDYpuQ/jlUKyIBpUnyLEIP8xSq3syxzTTY40I\n"
"YLV3PXZWz4Mu9Bnw5r35IkMEAjOKdpzuSynu33/xlEWXWnbjqGwQ2nTMofyJDwt1\n"
"Fe8S49rxBVIDfg3ocBTrl6e9oP9iNm5vkJeyc2P4L81iI74ZoQKvF3XZeTmF1QIE\n"
"H+eTeDPy11B09/StF5d/owUEp1WLy/1rB0zp8C1jz0Pm1wufljB4mKWGfS7E4XMu\n"
"YFnXOH3RN97LZR72vL2iNkSptkTRevAcxKIgI7OWjCvix9XYYYRoDfGz7ueBmksG\n"
"PG9RlyS7IBQKBB96uL/7VTnFV+1PAOocS9SCPUsMLItWA3Tuim45aBOAkD5nDQxj\n"
"6fzkoie15j0jKFqcFrx4ZX6rGiOWqeRVF98vboETfSq9PNWmRBzJQp6L/fsmZkQw\n"
"h0FVtyuS+BlanRUFusyzyzjeDr0Tt8z56sSDnojOovrH5EYn3WexFUsYOn7/ihfx\n"
"s3wB8V3CIduFeyFm9R/BKcnG8Z/+p0gybiyOFh8pI9xl5ziTYEw6Hkbj12FmT8P/\n"
"QtE9PR5MNGS91ydRbwQuaOof5PFF/m6vW++u3nyHFjaa4qWqjmhCfkf5Lh1difhq\n"
"BGaAAnZ32JqR46XBo2tfdfD2b31drJGxopzmYg60R0YrVIVi7PWkBDZGpaQTdq/f\n"
"vTqB5bs8HnWJ+uVZkwamNgP+tqmTGfMtX/V5ICQPxxyyVJGbB//6vXZu8BxKAPaC\n"
"MPC8jMEq4Ms1wi5GOWCJd81mX0qP2n/GTlAXUBDOVCHvAUwxez2IxHUpM0XkpNwG\n"
"N2Z13VrSVDut4TDgwwl37vCESTwy4wnAKpvDmeqYiyLxv8t9nObEqdOAKur1l1hK\n"
"6UlUQcN71hlMQXsdL8JN0yhoDZaxrRgkGJMsOn4WMtjS9bD7JOX94WTn4mF9DbWl\n"
"Hn/l2h9jmwwCDVpkBSPdv9xYTdNrFl+aprvtyVaNUsftqZz+p+0Xo1Hm7EdFAy3G\n"
"1G/pB3pFyK3WtZGAKlzs2XvnurAqtNZvjEOwP6NefopesanWNX9S3NpaVvekBXA2\n"
"rJVqWMubJ5HQBN92iEsqZEr5194nEpT7yi4biztMayv/BLCeFw3lss3tJ3I/RIga\n"
"sVfFmbkFCurNUs1T3IMa/uICrdXMYhcj5pkVXfBfrQn05HntGFwWcR2+v/tfaHiD\n"
"CQmEgnkVl+BM209kuUmzZvvQ0F/LNrZxyIsLmN+z/Siq+vybnz1a1T2A93dCDQ7U\n"
"RDPAdyYTHXV3gkSO9nBBeJ7xc1MoydjW+Ybeeh8VxMwY1hsPkhVXUdTUBbC0901W\n"
"6XPeNa/c13tTY9/vdrZXvXIyUwbpUthHbr5AI6+aNq+NwdCXkBZC5RHvrehDFr24\n"
"eMRoXd/Ryvh2gGmacpRMrGEPhhtCtoDHHszVAO3zkMCZeCeMzjRofTorSpJK5IN8\n"
"vvHglARPD5QErty/nfVqullwjYb50fNyBsoYDdENoH5B3EJywz37sQ9eUs8U3EVx\n"
"5dnvm7fvRx/9CCZfeMliYFv36XKvIq9ngr9xlM2Q5AovhOP11SSgPqBsM/lh9Wp+\n"
"TcIr2CYuPYmyRJqwwzuhEiU+ftmylaC+hML7RQBnc23WLYQgzqXLRD0rXuEQx1Ry\n"
"tfrFM+TeSzCW/H9+w7ULtbPB8TLxqRCAjCr2ggAs3kDaQykvc9suf1QfG/xW6Y0n\n"
"sLtnhX+upVGjA4S1PQAzcG7HM5TgaCSTG3bELyO2+Fd4sjCKFmEwrVQJq+emndA4\n"
"rY+FmLWfZitKKLvoKdG8Qkqk3YhMTHwFJGV+js4OZC59OzQPGJWpo2L0dScZCk2j\n"
"dRLOPZ/6lFJ44MfI19Gf6i0dSC5hMafhX6/zy2xLzTrPweK+nJDQLeX7/TYb/sLW\n"
"o6u5ZnqCj8N42n/fBOT4S4NHhA+ahEqEhg8r6XwX0Obdtoz37bscMa/cn+nQo8Hl\n"
"twsXzdsb0YYO+2WmEJD0RGGDhxkRQCDcXpRRAB1P//2pNEibZihbmFJBC9NaM6BR\n"
"WoAMQiV8EnThmfsNDQwP3xOCfMZzfHrS4FkoLl3eUR9QBbKuNp2oDqesWq1tvav3\n"
"wVPnFxdLXnssDDLOt7RUTXTnft/kSiNBu7L2BiB0w8XxkuM6VNwMim9G0KR4g+AC\n"
"AT+LstrMUkVS3epB+ZKe+OItSAnoCKDNicjO9I3tvdvG2s3oq0B96i/d1YeXN3t+\n"
"mAGf9bA07fns0T5XOfxe3LK5gxqaYGinGxNF8++S9BxSxSEtEPJBA+vjoCfxbDDs\n"
"gIPPwMCspP6cIuDowGv3iNHVayF0GMzpurlina/jtKd+QSCaUMLHSanfvEjrHNQU\n"
"4sgzCp4th/0qBn6W9uxGL/Byf871LurPw2DKfCsB8GmD6MhscFHRoVTqOKUUzisC\n"
"Amynn2A5gOs0BFhu8UpVhjDMOHLjUJ/jeoSp+PWfQeYdP4xN0K5whu833GS9W3cS\n"
"fhGN4bdzx2fg0n4DsouXvK4xyFARi+alr/lac5l/ogjcbxdMQQ62rrNPaMUWSRsO\n"
"eDp8k54gpej/sRnqqRr4LM6IyQ2I+96vEDnxUrcVTTS91Pi+CyyZPr/WKgrQ0dAI\n"
"viIQKqUJ3M/cjGL+XX222UeyryBvmnwtI7sU1LbJTCww+2dYxLixZMaNPgbrCfXt\n"
"EAX+YxccyKPFaG9AZyRMxktjHvLSxKPMSi/laZ2EWowsU37snFmkBsnaunNZaR/q\n"
"bNZQVjvRq1TDJ2IdxqBH74yQUgzcu6M4jXK+za5Jsq7A3oHR61LHwE8ZwyuIVIZz\n"
"J694sOt4DX9K4Q5b1idFfEZAEc78rC/GzSPnf+5SHLs00hU7XMgiP2ygJ6Nvr+kv\n"
"zUEz/TWom8FKOQQ/keXaun8Kgn96/Zeu2mWowvhijoNzryUrhhgSzmmfFIiI8cvo\n"
"R8GoGZq5CrwHAa1kCUhmWqykvtDf3o1O/3UTe/otc+HxhTqs8MiSFkNNiT6P61H/\n"
"G9BjsK/aznAwsAElWGhPQSuKtsFpBaMLy32Jqsh0tNthZrkUndIcksNibkc0QLJG\n"
"dyzMa6+FPRGZ1tL62jOoGCT/XbFpXVrHj2gGdm3Xxq/dn6fGMzjf4lLKMnXcF/8H\n"
"FYbVBQOhjSqHEZKEtUxyVcGE5M8H9R4cH0LBDB1I7fN6PuNrUMuDfkHzcKiiH2a2\n"
"BUr37+0KLl23OkCl8T+2D2LFVcRaLaFw0fztRNoaYngyvZQ46jqt/KjoXUXd+pzR\n"
"sNmc4rkdR5VZAQdFN5t/mFmQQSKghEzSuAr+yyPyw5y5hmpNfqy+pOkbnR8k7Cpf\n"
"U3rZq2w+wz52BZGu\n"
"-----END PRIVATE KEY-----";


#endif /* PEM_DATA_H */
```

## src/user_settings.h
```c
/* user_settings.h
 *
 * Copyright (C) 2006-2024 wolfSSL Inc.
 *
 * This file is part of wolfSSL.
 *
 * wolfSSL is free software; you can redistribute it and/or modify
 * it under the terms of the GNU General Public License as published by
 * the Free Software Foundation; either version 2 of the License, or
 * (at your option) any later version.
 *
 * wolfSSL is distributed in the hope that it will be useful,
 * but WITHOUT ANY WARRANTY; without even the implied warranty of
 * MERCHANTABILITY or FITNESS FOR A PARTICULAR PURPOSE.  See the
 * GNU General Public License for more details.
 *
 * You should have received a copy of the GNU General Public License
 * along with this program; if not, write to the Free Software
 * Foundation, Inc., 51 Franklin Street, Fifth Floor, Boston, MA 02110-1335, USA
 */

#ifndef USER_SETTINGS_H
#define USER_SETTINGS_H

#ifdef __cplusplus
extern "C" {
#endif

/* Post-Quantum */
#define WOLFSSL_HAVE_MLKEM
#define WOLFSSL_WC_MLKEM
#define HAVE_DILITHIUM
#define WOLFSSL_WC_DILITHIUM
#define WOLFSSL_SHAKE128
#define WOLFSSL_SHAKE256

/* WOLFSSL_NO_SHAKE128 and WOLFSSL_NO_SHAKE256 were removed below. */


/* ------------------------------------------------------------------------- */
/* Platform */
/* ------------------------------------------------------------------------- */
#define WOLFSSL_GENERAL_ALIGNMENT 4 /* platform requires 32-bit alignment on uint32_t */
#define SIZEOF_LONG_LONG 8          /* long long is 8 bytes / 64-bit */
//#define WOLFSSL_NO_ASM /* optionally disable inline assembly support */
#define WOLFSSL_IGNORE_FILE_WARN /* ignore file includes not required */
//#define WOLFSSL_SMALL_STACK /* option to reduce stack size, offload to heap */
#define BENCH_EMBEDDED /* use smaller buffers in benchmark / tests */

/* Network stack */
/* Default is POSIX sockets */
//#define WOLFSSL_USER_IO /* Use the SetIO callbacks, not the internal wolfio.c socket code */
//#define WOLFSSL_LWIP
//#define WOLFSSL_LWIP_NATIVE
//#define FREERTOS_TCP

/* RTOS */
/* Default is POSIX mutex and pthreads*/
//#define SINGLE_THREADED
//#define FREERTOS
#define NO_FILESYSTEM
#define NO_WRITEV
#define NO_MAIN_FUNCTION
#define NO_MAIN_DRIVER
#define NO_ASN_TIME
#define USE_CERT_BUFFERS_2048
#define USE_ANY_ADDR
/* ------------------------------------------------------------------------- */
/* Hardware */
/* ------------------------------------------------------------------------- */
/* CryptoCell support */
#if 0
    //#define WOLFSSL_CRYPTOCELL
    //#define WOLFSSL_CRYPTOCELL_AES
#endif
/* PSA support */
#ifdef CONFIG_MBEDTLS_PSA_CRYPTO_C
    #define WOLFSSL_HAVE_PSA
    #ifndef SINGLE_THREADED
        #define WOLFSSL_PSA_GLOBAL_LOCK
    #endif
    #define WC_NO_HASHDRBG /* use PSA RNG directly via wc_psa_get_random */
#endif

/* ------------------------------------------------------------------------- */
/* FIPS */
/* ------------------------------------------------------------------------- */
#ifdef CONFIG_WOLFCRYPT_FIPS
    /* FIPS Ready */
    #define HAVE_FIPS_VERSION 5
    #define HAVE_FIPS_VERSION_MINOR 3
#endif


/* ------------------------------------------------------------------------- */
/* TLS */
/* ------------------------------------------------------------------------- */
/* TLS v1.2 (on by default) */
#ifdef CONFIG_WOLFSSL_TLS_VERSION_1_2
    #undef  WOLFSSL_NO_TLS12
#else
    #define WOLFSSL_NO_TLS12
#endif
//#define NO_WOLFSSL_SERVER /* Optionally disable TLS server code */
//#define NO_WOLFSSL_CLIENT /* Optionally disable TLS client code */

/* TLS v1.3 */
#if defined(CONFIG_WOLFSSL_TLS_VERSION_1_3) || defined(CONFIG_WOLFSSL_TLS13_ENABLED)
    #define WOLFSSL_TLS13
#endif

/* Disable older TLS version prior to 1.2 */
#define NO_OLD_TLS

/* Enable default TLS extensions */
#define HAVE_TLS_EXTENSIONS
#define HAVE_SUPPORTED_CURVES
#define HAVE_EXTENDED_MASTER
#define HAVE_ENCRYPT_THEN_MAC
#define HAVE_SERVER_RENEGOTIATION_INFO
#define HAVE_SNI /* optional Server Name Indicator (SNI) */

/* ASN */
#define WOLFSSL_ASN_TEMPLATE /* use newer ASN template asn.c code (default) */
#if 0 /* optional space reductions */
    #define WOLFSSL_NO_ASN_STRICT
    #define IGNORE_NAME_CONSTRAINTS
#endif

/* Session Cache */
#if 0
    #define SMALL_SESSION_CACHE
    #ifdef WOLFSSL_TLS13
        #define HAVE_SESSION_TICKET /* session tickets required for resumption in TLS v1.3 */
    #endif
#else
    #define NO_SESSION_CACHE /* disable session resumption */
#endif

/* PSK */
#define NO_PSK /* disable pre-shared-key support */


/* ------------------------------------------------------------------------- */
/* Algorithms */
/* ------------------------------------------------------------------------- */
/* RNG */
#ifndef WC_NO_HASHDRBG
    #define HAVE_HASHDRBG /* Use DRBG SHA2-256 and seed */
#endif

/* ECC */
#if 1
    #define HAVE_ECC
    #define ECC_USER_CURVES      /* Enable only ECC curves specific */
    #undef  NO_ECC256            /* Enable SECP256R1 only (on by default) */
    #define ECC_TIMING_RESISTANT /* Enable Timing Resistance */

    //#define ECC_SHAMIR         /* Optional ECC calculation speed improvement if not using SP implementation */
    //#define WOLFSSL_CUSTOM_CURVES /* enable other curves (not just prime) */
    //#define HAVE_ECC_SECPR2
    //#define HAVE_ECC_SECPR3
    //#define HAVE_ECC_BRAINPOOL
    //#define HAVE_ECC_KOBLITZ
    //#define HAVE_ECC_CDH /* Co-factor */
    //#define HAVE_COMP_KEY /* Compressed key support */
    //#define FP_ECC /* Fixed point caching - speed repeated operations against same key */
    //#define HAVE_ECC_ENCRYPT
    //#define WOLFCRYPT_HAVE_ECCSI
    //#define WOLFSSL_ECDSA_DETERMINISTIC_K_VARIANT
#endif

#define WOLFSSL_OLD_PRIME_CHECK /* Use faster DH prime checking */

/* RSA */
#if 1
    #undef NO_RSA
    #define WC_RSA_BLINDING
    //#define WC_RSA_NO_PADDING
    //#define RSA_LOW_MEM

    #if 0
        #define WOLFSSL_KEY_GEN /* For RSA Key gen only */
    #endif
    #if defined(WOLFSSL_TLS13) || defined(CONFIG_WOLFSSL_RSA_PSS)
        /* TLS v1.3 requires RSA PSS padding */
        #define WC_RSA_PSS
        //#define WOLFSSL_PSS_LONG_SALT
    #endif
#else
    #define NO_RSA
#endif

/* DH */
#if 0
    #undef NO_DH /* on by default */
    #define WOLFSSL_DH_CONST /* don't rely on pow/log */
    #define HAVE_FFDHE_2048
    #define HAVE_FFDHE_3072
    #define HAVE_DH_DEFAULT_PARAMS
    //#define WOLFSSL_DH_EXTRA /* Enable additional DH key import/export */
#else
    #define NO_DH
#endif

/* ChaCha20 / Poly1305 */
#if 1
    #define HAVE_CHACHA
    #define HAVE_POLY1305

    /* Needed for Poly1305 */
    #define HAVE_ONE_TIME_AUTH
#endif

/* Ed25519 / Curve25519 */
#if 0
    #define HAVE_CURVE25519
    #define HAVE_ED25519 /* ED25519 Requires SHA512 */

    /* Optionally use small math (less flash usage, but much slower) */
    //#define CURVED25519_SMALL
#endif

/* SHA-1 */
#if 0
    #undef  NO_SHA /* on by default */
    //#define USE_SLOW_SHA /* 1k smaller, but 25% slower */
#else
    #define NO_SHA
#endif

/* SHA2-256 */
#if 1
    #undef NO_SHA256 /* on by default */
    //#define USE_SLOW_SHA256 /* ~2k smaller and about 25% slower */
    #define WOLFSSL_SHA224
#else
    #define NO_SHA256
#endif

/* SHA2-384/512 */
#if 1
    #define WOLFSSL_SHA384
    #define WOLFSSL_SHA512
    //#define USE_SLOW_SHA512 /* Over twice as small, but 50% slower */
#endif

/* SHA-3 */
#if 1
    #define WOLFSSL_SHA3
#endif

/* AES */
#define HAVE_AES_ECB
/* AES-CBC */
#if 1
    #define HAVE_AES_CBC
#else
    #define NO_AES_CBC
#endif
/* AES-GCM */
#if 1
    #define HAVE_AESGCM
    #define GCM_SMALL /* GCM Method: GCM_TABLE_4BIT, GCM_SMALL, GCM_WORD32 or GCM_TABLE */
    //#define WOLFSSL_AESGCM_STREAM
#endif
//#define HAVE_AES_DECRYPT
//#define WOLFSSL_AES_COUNTER
//#define WOLFSSL_AES_CFB
//#define WOLFSSL_AES_OFB
//#define HAVE_AESCCM
//#define WOLFSSL_AES_XTS

//#define NO_AES_128
//#define NO_AES_192
//#define NO_AES_256
//#define WOLFSSL_AES_SMALL_TABLES
//#define WOLFSSL_AES_NO_UNROLL


/* HKDF */
#if defined(WOLFSSL_TLS13) || defined(CONFIG_WOLFSSL_HKDF)
    #define HAVE_HKDF
#endif

/* CMAC - Zephyr nRF BTLE needs CMAC */
#if 1
    #define WOLFSSL_AES_DIRECT
    #define WOLFSSL_CMAC
#endif


/* Optional Features */
#define WOLFSSL_BASE64_ENCODE /* Enable Base64 encoding */
//#define WC_NO_CACHE_RESISTANT /* systems with cache should enable this for AES, ECC, RSA and DH */
//#define WOLFSSL_CERT_GEN
//#define WOLFSSL_CERT_REQ
//#define WOLFSSL_CERT_EXT
//#define NO_PWDBASED


/* Disable Algorithms */
#define NO_DSA
#define NO_RC4
#define NO_MD4
#define NO_MD5
#define NO_DES3

/* ------------------------------------------------------------------------- */
/* Math */
/* ------------------------------------------------------------------------- */
/* Math Options */
/* Multi-precision - generic math for all keys sizes and curves */
#if 1
    #define WOLFSSL_SP_MATH /* no multi-precision math, only single */
#elif 1
    /* wolf mp math (sp_int.c) */
    #define WOLFSSL_SP_MATH_ALL /* use SP math for all key sizes and curves */
    //#define WOLFSSL_SP_NO_MALLOC

    /* use smaller version of code */
    #define WOLFSSL_SP_SMALL

    /* Define the maximum math bits used */
    #if !defined(NO_RSA) || !defined(NO_DH)
        #define SP_INT_BITS 2048
    #elif defined(HAVE_ECC)
        #define SP_INT_BITS 256
    #endif

#elif 1
    /* Fast Math (tfm.c) (stack based and timing resistant) */
    #define USE_FAST_MATH
    #define TFM_TIMING_RESISTANT

    /* Define the maximum math bits used (2 * max) */
    #if !defined(NO_RSA) || !defined(NO_DH)
        #define FP_MAX_BITS (2*2048)
        #ifdef HAVE_ECC
            #define ALT_ECC_SIZE /* use heap allocation for ECC point */
        #endif
    #elif defined(HAVE_ECC)
        #define FP_MAX_BITS (2*256)
    #endif
    #ifdef HAVE_ECC
        //#define TFM_ECC256 /* optional speedup for ECC-256 bit */
    #endif
#else
    /* Normal (integer.c) (heap based, not timing resistant) - not recommended */
    #define USE_INTEGER_HEAP_MATH
#endif

/* Single Precision (optional) */
/* Math written for specific curves and key sizes */
#if 1
    #ifdef HAVE_ECC
        #define WOLFSSL_HAVE_SP_ECC
        //#define WOLFSSL_SP_NO_256
        //#define WOLFSSL_SP_384
        //#define WOLFSSL_SP_521
    #endif
    #ifndef NO_RSA
        #define WOLFSSL_HAVE_SP_RSA
        //#define WOLFSSL_SP_NO_2048
        //#define WOLFSSL_SP_NO_3072
        //#define WOLFSSL_SP_4096
    #endif
    #ifndef NO_DH
        #define WOLFSSL_HAVE_SP_DH
    #endif

    #define WOLFSSL_SP_SMALL      /* use smaller version of code */
    //#define WOLFSSL_SP_NO_MALLOC /* disable heap in wolf/SP math */
    //#define SP_DIV_WORD_USE_DIV /* no div64 */

    #if 0
        /* optional speedup with inline assembly */
        //#define WOLFSSL_SP_ARM_CORTEX_M_ASM /* Cortex-M3+ */
        //#define WOLFSSL_SP_ARM_THUMB_ASM    /* Cortex-M0+ thumb */
        //#define WOLFSSL_SP_ARM32_ASM        /* Cortex-R */
        //#define WOLFSSL_SP_ARM64_ASM        /* Cortex-A */
        //#define WOLFSSL_SP_USE_UDIV
    #endif
#endif

/* ------------------------------------------------------------------------- */
/* Assembly Speedups for Symmetric Algorithms */
/* ------------------------------------------------------------------------- */

#ifdef CONFIG_WOLFCRYPT_ARMASM
    #define WOLFSSL_ARMASM
    #define WOLFSSL_NO_HASH_RAW
    #define WOLFSSL_ARMASM_INLINE /* use inline .c versions */
    #define WOLFSSL_ARMASM_NO_NEON

    /* Default is ARMv8 */

    #if 0 /* ARMv7 */
        #define WOLFSSL_ARM_ARCH 7
        #define WOLFSSL_ARMASM_NO_HW_CRYPTO /* enable if processor does not support aes/sha instructions */
    #endif
#endif

#ifdef CONFIG_WOLFCRYPT_INTELASM
    #define USE_INTEL_SPEEDUP
    #define WOLFSSL_X86_64_BUILD /* 64-bit */
    //#define WOLFSSL_X86_BUILD /* 32-bit */

    /* Issues with building AESNI "_mm_aesimc_si128" always_inline */
    //#define WOLFSSL_AESNI
#endif


/* ------------------------------------------------------------------------- */
/* Debugging */
/* ------------------------------------------------------------------------- */
#undef DEBUG_WOLFSSL
//#define DEBUG_WOLFSSL
#undef NO_ERROR_STRINGS
//#define NO_ERROR_STRINGS


#ifdef __cplusplus
}
#endif

#endif /* USER_SETTINGS_H */
```
