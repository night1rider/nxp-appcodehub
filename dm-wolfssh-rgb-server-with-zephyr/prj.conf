## CMakeLists.txt
```
cmake_minimum_required(VERSION 3.20.0)

find_package(Zephyr REQUIRED HINTS $ENV{ZEPHYR_BASE})
project(wolfssh-rgb-server)

# Check if the symbolic link __repo__ exists
if(NOT EXISTS "${CMAKE_SOURCE_DIR}/__repo__")
    # Create a symbolic link from __repo__ to the ZEPHYR_BASE environment variable
    execute_process(
        COMMAND ${CMAKE_COMMAND} -E create_symlink $ENV{ZEPHYR_BASE}/.. ${CMAKE_SOURCE_DIR}/__repo__
        COMMAND_ECHO STDOUT
    )
endif()

target_sources(app PRIVATE src/main.c)
target_sources(app PRIVATE __repo__/modules/crypto/wolfssl/wolfcrypt/test/test.c)
target_sources(app PRIVATE __repo__/modules/crypto/wolfssl/wolfcrypt/benchmark/benchmark.c)
target_include_directories(app PRIVATE src)

add_definitions(-DWOLFSSH_USER_SETTINGS)
add_definitions(-DWOLFSSL_USER_SETTINGS)
```

## sample.yaml
```
sample:
  description: A RGB light server using SSH protocol on Zephyr
  name: RGB Light Server using SSH
tests:
  sample.basic.wolfssh:
    tags:
      - Ethernet
      - Networking
      - SSH
      - GPIO
```

## west.yml
```
manifest:
  defaults:
    remote: zephyrproject-rtos

  remotes:
    - name: zephyrproject-rtos
      url-base: https://github.com/zephyrproject-rtos
    - name: wolfssl
      url-base: https://github.com/wolfssl
    - name: wolfssh
      url-base: https://github.com/wolfssl

  projects:
    - name: zephyr
      remote: zephyrproject-rtos
      revision: v4.0.0
      import:
        - name-allowlist:
          - hal_nxp
          - cmsis
          - segger
    - name: wolfssl
      path: modules/crypto/wolfssl
      revision: v5.7.6-stable
      remote: wolfssl
    - name: wolfssh
      path: modules/lib/wolfssh
      revision: v1.4.18-stable
      remote: wolfssh
```

## prj.conf
```kconfig
CONFIG_UART_CONSOLE=y

# Clock for time()
CONFIG_CLOCK_CONTROL=y
CONFIG_POSIX_CLOCK=y

# Log settings. Using immediate mode to not drop bursty logs
CONFIG_LOG=y
CONFIG_LOG_PRINTK=n
CONFIG_NET_IF_LOG_LEVEL_DBG=y

# Stack size for crypto operations (20KB is needed for wolfSSL/wolfSSH)
CONFIG_MAIN_STACK_SIZE=32768
# Heap memory pool size
CONFIG_HEAP_MEM_POOL_SIZE=32768

CONFIG_ASSERT=y

# POSIX Settings
CONFIG_POSIX_API=y
CONFIG_NET_SOCKETS_POSIX_NAMES=y
CONFIG_PTHREAD_IPC=y

# Enable float support for printf/printk
CONFIG_CBPRINTF_FP_SUPPORT=y

# Network settings
CONFIG_NETWORKING=y
CONFIG_NET_CONFIG_SETTINGS=y
CONFIG_NET_L2_ETHERNET=y
CONFIG_NET_IPV4=y
CONFIG_NET_DHCPV4=y
CONFIG_NET_SOCKETS=y
CONFIG_NET_TCP=y 
CONFIG_DNS_RESOLVER=y

# IPv4
#CONFIG_NET_CONFIG_NEED_IPV4=y
#CONFIG_NET_CONFIG_MY_IPV4_ADDR="192.168.1.70"
#CONFIG_NET_CONFIG_PEER_IPV4_ADDR="192.168.1.174"
#CONFIG_NET_CONFIG_MY_IPV4_GW="192.168.1.1"

# TLS configuration
CONFIG_WOLFSSL=y
CONFIG_WOLFSSL_BUILTIN=y
CONFIG_WOLFSSL_SETTINGS_FILE="user_settings.h"
CONFIG_WOLFSSL_TLS_VERSION_1_2=y
CONFIG_WOLFSSL_TLS_VERSION_1_3=y
CONFIG_WOLFSSL_KEY_EXCHANGE_ALL_ENABLED=y
CONFIG_WOLFSSL_CIPHER_ALL_ENABLED=y
CONFIG_WOLFSSL_MAC_ALL_ENABLED=y
CONFIG_WOLFSSL_HMAC_DRBG_ENABLED=y

# Enable wolfSSH
CONFIG_WOLFSSH=y
CONFIG_WOLFSSH_SETTINGS_FILE="user_settings.h"

#CONFIG_NET_BUF_DATA_SIZE=512
CONFIG_NET_BUF_DATA_SIZE=1536
CONFIG_NET_BUF_RX_COUNT=32

CONFIG_ENTROPY_GENERATOR=y
CONFIG_TEST_RANDOM_GENERATOR=y

#ETHERNET
CONFIG_ETH_NXP_ENET_QOS=y
CONFIG_ETH_NXP_ENET_QOS_MAC=y

#LED'S
CONFIG_GPIO=y

# Debugging
CONFIG_WOLFSSH_DEBUG=n
CONFIG_WOLFSSL_DEBUG=n
CONFIG_DEBUG=y

# Enable debugging options
#CONFIG_ASSERT=y
#CONFIG_THREAD_STACK_INFO=y
#CONFIG_INIT_STACKS=y
#CONFIG_THREAD_MONITOR=y
#CONFIG_THREAD_RUNTIME_STATS=y



# Enable logging using RTT and UART
#CONFIG_CBPRINTF_LIBC_SUBSTS=y
#CONFIG_CBPRINTF_FP_SUPPORT=y
#CONFIG_CONSOLE=y
#CONFIG_LOG_BACKEND_UART=y
#CONFIG_LOG_BUFFER_SIZE=15360
```

## src/main.c
```c
/* main.c
 *
 * Copyright (C) 2006-2023 wolfSSL Inc.
 *
 * This file is part of wolfSSL.
 *
 * wolfSSL is free software; you can redistribute it and/or modify
 * it under the terms of the GNU General Public License as published by
 * the Free Software Foundation; either version 2 of the License, or
 * (at your option) any later version.
 *
 * wolfSSL is distributed in the hope that it will be useful,
 * but WITHOUT ANY WARRANTY; without even the implied warranty of
 * MERCHANTABILITY or FITNESS FOR A PARTICULAR PURPOSE.  See the
 * GNU General Public License for more details.
 *
 * You should have received a copy of the GNU General Public License
 * along with this program; if not, write to the Free Software
 * Foundation, Inc., 51 Franklin Street, Fifth Floor, Boston, MA 02110-1335, USA
 */

/* wolfSSL Includes Start	*/
#include "user_settings.h"
#include <wolfssl/wolfcrypt/settings.h>
#include <wolfssl/ssl.h>
#include <wolfssl/certs_test.h>
#include <wolfssl/wolfcrypt/hash.h>
#include <wolfssl/wolfcrypt/hash.h>
#include <wolfssl/wolfcrypt/coding.h>
#include <wolfssl/wolfcrypt/wc_port.h>
#include <wolfssl/wolfcrypt/asn.h>
#include <wolfssl/wolfcrypt/asn_public.h>
#include <wolfssl/wolfcrypt/error-crypt.h>
#include <wolfssl/wolfcrypt/ecc.h>

/* wolfSSL Includes End */

/* wolfSSH Includes Start */
#include <wolfssh/ssh.h>
#include <wolfssh/internal.h>
#include <wolfssh/agent.h>
#include <wolfssh/certs_test.h>

#ifdef WOLFCRYPT_TEST
#include <wolfcrypt/test/test.h>
#endif

#ifdef WOLFCRYPT_BENCHMARK
#include <wolfcrypt/benchmark/benchmark.h>
#endif

/* wolfSSH Includes End */

/* Standard Packages Start */
#include <stdio.h>
#include <time.h>

/* Standard Packages End */

/* Zephyr Includes Start */
#include <zephyr/kernel.h>
#include <zephyr/drivers/gpio.h>
#include <zephyr/net/net_if.h>
#include <zephyr/net/dhcpv4.h>
#include <zephyr/net/net_core.h>
#include <zephyr/net/net_context.h>
#include <zephyr/net/net_mgmt.h>
#include <zephyr/net/net_config.h>
#include <zephyr/net/net_ip.h>

/* Zephyr Includes End */

/* Sample key */
#include "public_key.h"


/* Program Defines Start */

#define DEFAULT_PORT 11111 /* Define the port we want to use for
                            * the network */

#define LOCAL_DEBUG 0 /* Use for wolfSSL's internal Debugging */

#define BUFFER_SIZE 256

/* Use DHCP auto IP assignment or static assignment */
#undef	DHCP_ON
#define DHCP_ON 1   /* Set to true (1) if you want auto assignment IP, */
                    /* set false (0) for statically defined. */
                    /* Make sure to avoid IP conflicts on the network you */
                    /* assign this to, check the defaults before using. */
                    /* If unsure, leave DHCP_ON set to 1 */

#if DHCP_ON == 0
/* Define Static IP, Gateway, and Netmask */
    #define STATIC_IPV4_ADDR  "192.168.1.70"
    #define STATIC_IPV4_GATEWAY "192.168.1.1"
    #define STATIC_IPV4_NETMASK "255.255.255.0"
#endif

/* Set the TLS Version. Currently only 2 or 3 is available for this */
/* application, defaults to TLSv3 */
#undef TLS_VERSION
#define TLS_VERSION 2

/* wolfSSH Login Defines */
#define USER_NAME "zephyr" 
#define USER_PASSWORD "zephyr"

#define USER_KEY publicKeyRSA
#define USER_KEY_SIZE publicKeyRSA_size

/* The devicetree node identifier for the RGB LED determined */
/* by looking at the device tree alias */

#define RED_LED DT_ALIAS(led0)
#define BLUE_LED DT_ALIAS(led2)
#define GREEN_LED DT_ALIAS(led1)

/* Program Defines End */


/* Global Variables/Structs Start */

static const struct gpio_dt_spec red = GPIO_DT_SPEC_GET(RED_LED, gpios);
static const struct gpio_dt_spec blue = GPIO_DT_SPEC_GET(BLUE_LED, gpios);
static const struct gpio_dt_spec green = GPIO_DT_SPEC_GET(GREEN_LED, gpios);
bool redStatus = true;
bool blueStatus =  true;
bool greenStatus = true;

/* Global Variables/Structs End */


int startNetwork()
{
    struct net_if *iface = net_if_get_default();
    char buf[NET_IPV4_ADDR_LEN];

    #if DHCP_ON == 0
        struct in_addr addr, netmask, gw;
    #endif

    if (!(iface)) { /* See if a network interface (Ethernet) is available */
        printf("No network interface determined\n");
        return 1;
    }

    if (net_if_flag_is_set(iface, NET_IF_DORMANT)) {
        printf("Waiting on network interface to be available\n");
        while(!net_if_is_up(iface)){
            k_sleep(K_MSEC(100));
        }
    }

    #if DHCP_ON == 1
        printf("\nStarting DHCP to obtain IP address\n");
        net_dhcpv4_start(iface);
        (void)net_mgmt_event_wait_on_iface(iface, NET_EVENT_IPV4_DHCP_BOUND, \
                                            NULL, NULL, NULL, K_FOREVER);
    #elif DHCP_ON == 0
        /* Static IP Configuration */
        if (net_addr_pton(AF_INET, STATIC_IPV4_ADDR, &addr) < 0 ||
            net_addr_pton(AF_INET, STATIC_IPV4_NETMASK, &netmask) < 0 ||
            net_addr_pton(AF_INET, STATIC_IPV4_GATEWAY, &gw) < 0) {
            printf("Invalid IP address settings.\n");
            return -1;
        }
        net_if_ipv4_set_netmask_by_addr(iface, &addr, &netmask);
        net_if_ipv4_set_gw(iface, &gw);
        net_if_ipv4_addr_add(iface, &addr, NET_ADDR_MANUAL, 0);


    #else
        #error "Please set DHCP_ON to true (1) or false (0), if unsure set to true (1)"
    #endif


    /* Display IP address that was assigned when done */
    printf("IP Address is: %s\n", net_addr_ntop(AF_INET, \
        &iface->config.ip.ipv4->unicast[0].ipv4.address.in_addr, \
        buf, sizeof(buf)));

    return 0;
}

void handleClientCommunication(WOLFSSH* ssh)
{
    char buffer[BUFFER_SIZE];
    char message[BUFFER_SIZE];
    int ret;
    int message_len = 0;
    const char* backspace_seq = "\b \b";
    wolfSSH_stream_send(ssh, \
        (byte*)("Send Commands: 'red', 'green', and 'blue' to control led\r\n"), \
        strlen("Send Commands: 'red', 'green', and 'blue' to control led\r\n"));
    wolfSSH_stream_send(ssh, \
        (byte*)("Send Command: 'close' to end connection\r\n"), \
        strlen("Send Command: 'close' to end connection\r\n"));
    while (1) {
        memset(buffer, 0, sizeof(buffer));
        ret = wolfSSH_stream_read(ssh, (byte*)buffer, sizeof(buffer) - 1);
        if (ret <= 0) {
            printf("Connection closed or error occurred\n");
            break;
        }

        for (int i = 0; i < ret; i++) {
            /* Handle backspace character (ASCII 8 or 127) */
            if (buffer[i] == '\b' || buffer[i] == 127) {
                if (message_len > 0) {
                    message_len--;
                    /* Send backspace, space, and backspace to the client to */
                    /* visually remove the character */
                    wolfSSH_stream_send(ssh, (byte*)backspace_seq, \
                                        strlen(backspace_seq));
                }
            } else {
                /* Echo each character back to the client */
                 wolfSSH_stream_send(ssh, (byte*)&buffer[i], 1);

                if (buffer[i] == '\n' || buffer[i] == '\r') {
                    if (message_len > 0) {
                        /* Null-terminate the command */
                        message[message_len] = '\0';
                        /* Server-side logging */
                        printf("Received: %s\n", message);

                        /* Echo back the received message with a newline */
                        /* character (server-side command processing) */
                        wolfSSH_stream_send(ssh, (byte*)"\r\n", 2);

                        if (strcmp(message, "close") == 0) {
                            printf("Closing connection as requested by client\n");
                            return; /* Exit the function to close the connection */
                        }
                        else if (strcmp(message, "red") == 0 || \
                                    strcmp(message, "blue") == 0 || \
                                    strcmp(message, "green") == 0) {
                            switch (message[0]) {
                                case 'r':
                                    redStatus = !redStatus;
                                    wolfSSH_stream_send(ssh, \
                                            (byte*)("Red Led Toggling: "), \
                                            strlen("Red Led Toggling: "));
                                    if(!redStatus){
                                            wolfSSH_stream_send(ssh, \
                                                (byte*)("Off\r\n"), \
                                                strlen("Off\r\n"));
                                    }
                                    else{
                                            wolfSSH_stream_send(ssh, \
                                                (byte*)("On\r\n"), \
                                                strlen("On\r\n"));
                                    }
                                    if(gpio_pin_toggle_dt(&red) < 0){
                                        return;
                                    }
                                    break;
                                case 'g':
                                    greenStatus = !greenStatus;
                                    wolfSSH_stream_send(ssh, \
                                            (byte*)("Green Led Toggling: "), \
                                            strlen("Green Led Toggling: "));
                                    if(!greenStatus){
                                            wolfSSH_stream_send(ssh, \
                                                (byte*)("Off\r\n"), \
                                                strlen("Off\r\n"));
                                    }
                                    else{
                                            wolfSSH_stream_send(ssh, \
                                                (byte*)("On\r\n"), \
                                                strlen("On\r\n"));
                                    }
                                    if(gpio_pin_toggle_dt(&green) < 0){
                                        return;
                                    }
                                    break;
                                case 'b':
                                    blueStatus = !blueStatus;
                                    wolfSSH_stream_send(ssh, \
                                            (byte*)("Blue Led Toggling: "), \
                                            strlen("Blue Led Toggling: "));
                                    if(!blueStatus){
                                            wolfSSH_stream_send(ssh, \
                                                (byte*)("Off\r\n"), \
                                                strlen("Off\r\n"));
                                    }
                                    else{
                                            wolfSSH_stream_send(ssh, \
                                                (byte*)("On\r\n"), \
                                                strlen("On\r\n"));
                                    }
                                    if(gpio_pin_toggle_dt(&blue) < 0){
                                        return;
                                    }
                                    break;
                                default:

                                    break;
                            }
                        }
                        /* Reset the message length for the next message */
                        message_len = 0; 
                    }
                } else {
                    message[message_len++] = buffer[i];
                    if (message_len >= BUFFER_SIZE - 1) {
                        printf("Message too long, resetting buffer\n");
                        message_len = 0;
                    }
                }
            }
        }
    }
}


/* Callback function for user authentication */
static int wsUserAuthCallback(byte authType, WS_UserAuthData* authData, void* ctx) {
    if (authType == WOLFSSH_USERAUTH_PASSWORD) {
        /* Print received username for debugging */
        printf("Received username: %s\n", authData->username);

        /* Print received password as hex for debugging */
        /* (avoid printing raw password) */
        printf("Received password (hex): ");
        for (int i = 0; i < authData->sf.password.passwordSz; i++) {
            printf("%02X", authData->sf.password.password[i]);
        }
        printf("\n");

        /* Ensure the received password is null-terminated */
        /* (add one extra byte to buffer if necessary) */
        char receivedPassword[authData->sf.password.passwordSz + 1];
        memcpy(receivedPassword, authData->sf.password.password, \
                authData->sf.password.passwordSz);
        receivedPassword[authData->sf.password.passwordSz] = '\0';

        /* Compare received username and password with expected values */
        if (strcmp(authData->username, USER_NAME) == 0 &&
            strcmp(receivedPassword, USER_PASSWORD) == 0) {
            printf("Authentication successful\n");
            return WOLFSSH_USERAUTH_SUCCESS;
        } else {
            printf("Authentication failed\n");
        }
    } else if (authType == WOLFSSH_USERAUTH_PUBLICKEY) {
        /* Verify both the username and the public key */
        if (strcmp(authData->username, USER_NAME) == 0) {
            printf("Received public key of size: %d\n", authData->sf.publicKey.publicKeySz);
            printf("Known public key size: %d\n", USER_KEY_SIZE);

            printf("Received public key (hex): ");
            for (int i = 0; i < authData->sf.publicKey.publicKeySz; i++) {
                printf("%02X", authData->sf.publicKey.publicKey[i]);
            }
            printf("\n");

            printf("Known public key (hex): ");
            for (int i = 0; i < USER_KEY_SIZE; i++) {
                printf("%02X", USER_KEY[i]);
            }
            printf("\n");

            if (authData->sf.publicKey.publicKeySz == USER_KEY_SIZE &&
                XMEMCMP(authData->sf.publicKey.publicKey, USER_KEY, USER_KEY_SIZE) == 0) {
                printf("Public key authentication successful\n");
                return WOLFSSH_USERAUTH_SUCCESS;
            } else {
                printf("Public key authentication failed\n");
            }
        } else {
            printf("Username check failed\n");
        }
    }
    return WOLFSSH_USERAUTH_FAILURE;
}


int startServer(void)
{
    WOLFSSH_CTX* sshCTX;
    const char *bannerMSG = "wolfSSH Zephyr Server\n";

#ifdef WOLFCRYPT_TEST
    printf("\nRunning wolfCrypt test\n");
    wolfcrypt_test(NULL);
#endif

#ifdef WOLFCRYPT_BENCHMARK
        printf("\nRunning wolfCrypt benchmark\n");
        benchmark_test(NULL);
#endif


    printf("Starting SSH server\n");

    if (wolfSSH_Init() != WS_SUCCESS) {
        printf("Error with wolfSSH init\n");
        return 1;
    }

    #if LOCAL_DEBUG == 1
        printf("Turning on wolfSSH debugging\n");
        wolfSSH_Debugging_ON();
    #endif

    sshCTX = wolfSSH_CTX_new(WOLFSSH_ENDPOINT_SERVER, NULL);
    if (sshCTX == NULL) {
        printf("wolfSSH ctx allocation failed\n");
        return 1;
    }

    if (wolfSSH_CTX_SetBanner(sshCTX, bannerMSG) != WS_SUCCESS) {
        printf("Failed to set banner Message for client\n");
        return 1;
    }

    wolfSSH_SetUserAuth(sshCTX, wsUserAuthCallback);

    /* Use the embedded server key */
    if (wolfSSH_CTX_UsePrivateKey_buffer(sshCTX, rsa_key_der_2048, \
            sizeof_rsa_key_der_2048, WOLFSSH_FORMAT_ASN1) != WS_SUCCESS) {
        printf("Error using server key\n");
        return 1;
    }

    /* Create socket */
    int sockfd = socket(AF_INET, SOCK_STREAM, 0);
    if (sockfd < 0) {
        perror("socket");
        return 1;
    }

    /* Bind socket */
    struct sockaddr_in addr;
    memset(&addr, 0, sizeof(addr));
    addr.sin_family = AF_INET;
    addr.sin_addr.s_addr = INADDR_ANY;
    addr.sin_port = htons(DEFAULT_PORT);

    if (bind(sockfd, (struct sockaddr*)&addr, sizeof(addr)) < 0) {
        perror("bind");
        return 1;
    }

    /* Listen on socket */
    if (listen(sockfd, 5) < 0) {
        perror("listen");
        return 1;
    }


    /* Accept connections */
    while (1) {
        printf("The Server is ready for connections\n");
        int clientfd = accept(sockfd, NULL, NULL);
        if (clientfd < 0) {
            printf("accept"); 
            perror("accept");
            continue;
        }

        WOLFSSH* ssh = wolfSSH_new(sshCTX);
        if (ssh == NULL) {
            printf("Error creating SSH session\n");
            close(clientfd);
        }

        wolfSSH_set_fd(ssh, clientfd);

        if (wolfSSH_accept(ssh) == WS_SUCCESS) {
            printf("Client connected\n");
            handleClientCommunication(ssh);
        } else {
            printf("SSH accept failed\n");
        }
        wolfSSH_free(ssh);
        close(clientfd);
    }

    /* Cleanup */
    wolfSSH_CTX_free(sshCTX);

    #if LOCAL_DEBUG == 1
        printf("Turning off wolfSSH debugging\n");
        wolfSSH_Debugging_OFF();
    #endif

    if (wolfSSH_Cleanup() != WS_SUCCESS) {
        printf("Error with wolfSSH cleanup\n");
    }

    close(sockfd);

    printf("SSH Server is off\n");
    return 0;
}

int main(int argc, char** argv)
{
    printf("\nRunning wolfSSH example from the %s!\n", CONFIG_BOARD);

    /* Setting Up GPIO for LEDs */
    if (!gpio_is_ready_dt(&red)){
        return 0;
    }
    if (!gpio_is_ready_dt(&blue)){
        return 0;
    }
    if (!gpio_is_ready_dt(&green)) {
        return 0;
    }

    if (gpio_pin_configure_dt(&red, GPIO_OUTPUT_ACTIVE) < 0){
        return 0;
    }
    
    if (gpio_pin_configure_dt(&blue, GPIO_OUTPUT_ACTIVE) < 0){
        return 0;
    }
    if (gpio_pin_configure_dt(&green, GPIO_OUTPUT_ACTIVE) < 0){
        return 0;
    }


    /* Start up the network */
    if (startNetwork() != 0){
        printf("Network Initialization via DHCP Failed\n");
        return 1;
    }

    /* Start SSH server */
    if (startServer() != 0){
        printf("Server has Failed!\n");
        return 1;
    }

    return 0;
}
```

## src/public_key.h
```c
/* public_key_array.h
 *
 * Copyright (C) 2014-2024 wolfSSL Inc.
 *
 * This file is part of wolfSSH.
 *
 * wolfSSH is free software; you can redistribute it and/or modify
 * it under the terms of the GNU General Public License as published by
 * the Free Software Foundation; either version 3 of the License, or
 * (at your option) any later version.
 *
 * wolfSSH is distributed in the hope that it will be useful,
 * but WITHOUT ANY WARRANTY; without even the implied warranty of
 * MERCHANTABILITY or FITNESS FOR A PARTICULAR PURPOSE.  See the
 * GNU General Public License for more details.
 *
 * You should have received a copy of the GNU General Public License
 * along with wolfSSH.  If not, see <http://www.gnu.org/licenses/>.
 */

/* test_key/public_key.der */

static const unsigned char publicKeyRSA[] = 
{
0x00, 0x00, 0x00, 0x07, 0x73, 0x73, 0x68, 0x2d, 0x72, 0x73, 0x61, 0x00, 0x00, 
0x00, 0x03, 0x01, 0x00, 0x01, 0x00, 0x00, 0x01, 0x01, 0x00, 0xcb, 0x67, 0x22, 
0x81, 0x90, 0xe5, 0xa4, 0x14, 0xfe, 0x5f, 0x63, 0x09, 0x1c, 0x0a, 0x07, 0x9d, 
0xf7, 0x85, 0x7f, 0xaf, 0x8b, 0x1e, 0x6e, 0x81, 0x0e, 0x40, 0x13, 0xf1, 0x5f, 
0x5e, 0x8c, 0x70, 0x38, 0x75, 0x8d, 0x00, 0x7a, 0x96, 0xfa, 0x35, 0xb5, 0x7a, 
0xbb, 0xfa, 0x18, 0x66, 0x5b, 0x9e, 0x28, 0xf7, 0x80, 0x67, 0x71, 0x8d, 0xce, 
0xd4, 0x7d, 0xb3, 0x3a, 0x0b, 0xe8, 0x54, 0xa5, 0x32, 0xf9, 0x1d, 0xf6, 0x8a, 
0xaf, 0x7e, 0x8c, 0x63, 0x4c, 0x6b, 0xbb, 0xd5, 0x3d, 0x3d, 0xf3, 0x5c, 0x9b, 
0x25, 0xe9, 0x6a, 0xa8, 0x60, 0x13, 0x1a, 0xd7, 0xaf, 0x1d, 0x4e, 0x89, 0x92, 
0x8f, 0xc8, 0xd3, 0xe9, 0x60, 0x49, 0x01, 0x4a, 0x59, 0x02, 0x7b, 0x0f, 0x70, 
0xe3, 0xdb, 0x39, 0x59, 0xa4, 0x85, 0xc1, 0xd9, 0x0e, 0xf1, 0x97, 0xf8, 0xbd, 
0x90, 0x56, 0x60, 0x68, 0x8a, 0x85, 0x85, 0x41, 0xdd, 0x58, 0xef, 0x49, 0x30, 
0xec, 0x02, 0x17, 0x0a, 0x03, 0xae, 0x17, 0x7c, 0xbf, 0x9c, 0x64, 0xcb, 0x5b, 
0xf7, 0x38, 0x82, 0x19, 0x0f, 0x18, 0x98, 0xc5, 0x52, 0x0a, 0x6d, 0xfd, 0x89, 
0xd3, 0xb5, 0x9b, 0xc2, 0x24, 0x85, 0x03, 0x15, 0xdf, 0x89, 0x7f, 0x13, 0x8d, 
0x40, 0x43, 0x2c, 0x59, 0xad, 0xaa, 0xdd, 0x40, 0x17, 0xa2, 0xe3, 0x03, 0x21, 
0xb2, 0x69, 0x12, 0x02, 0x5e, 0x46, 0x86, 0x25, 0x0f, 0xd0, 0x27, 0xdb, 0x17, 
0xf3, 0x98, 0x7d, 0x6e, 0x48, 0x8f, 0x94, 0x63, 0x40, 0xb5, 0x01, 0x90, 0xb4, 
0xd5, 0x20, 0xde, 0xd0, 0xbd, 0x1a, 0xa3, 0xa4, 0x67, 0xdb, 0x42, 0x29, 0x8d, 
0x44, 0x7e, 0x1f, 0xeb, 0xd3, 0x3a, 0x2c, 0x38, 0x0e, 0xee, 0x7f, 0x18, 0x3a, 
0xca, 0x62, 0xe9, 0xab, 0x50, 0xb8, 0x2d, 0x4f, 0xf8, 0x10, 0xd1, 0x87, 0x92, 
0xe4, 0x4f, 0x00, 0xab, 0xee, 0xf3
};

static const unsigned int publicKeyRSA_size = sizeof(publicKeyRSA);
```

## src/user_settings.h
```c
/* wolfssl_user_settings.h
 *
 * Copyright (C) 2014-2024 wolfSSL Inc.
 *
 * This file is part of wolfSSH.
 *
 * wolfSSH is free software; you can redistribute it and/or modify
 * it under the terms of the GNU General Public License as published by
 * the Free Software Foundation; either version 3 of the License, or
 * (at your option) any later version.
 *
 * wolfSSH is distributed in the hope that it will be useful,
 * but WITHOUT ANY WARRANTY; without even the implied warranty of
 * MERCHANTABILITY or FITNESS FOR A PARTICULAR PURPOSE.  See the
 * GNU General Public License for more details.
 *
 * You should have received a copy of the GNU General Public License
 * along with wolfSSH.  If not, see <http://www.gnu.org/licenses/>.
 */

#ifndef WOLFSSL_USER_SETTINGS_H
#define WOLFSSL_USER_SETTINGS_H

#ifdef __cplusplus
extern "C" {
#endif


/* #define WOLFCRYPT_TEST */
/* #define WOLFCRYPT_BENCHMARK */
#define NO_MAIN_DRIVER

#undef  WOLFSSL_ZEPHYR
#define WOLFSSL_ZEPHYR

#undef  WOLFSSL_SMALL_STACK
#define WOLFSSL_SMALL_STACK



#undef  TFM_TIMING_RESISTANT
#define TFM_TIMING_RESISTANT

#undef  ECC_TIMING_RESISTANT
#define ECC_TIMING_RESISTANT

#undef  WC_RSA_BLINDING
#define WC_RSA_BLINDING

#undef  HAVE_AESGCM
#define HAVE_AESGCM

#undef  WOLFSSL_SHA512
#define WOLFSSL_SHA512

#undef  WOLFSSL_SHA384
#define WOLFSSL_SHA384

#undef  NO_DSA
#define NO_DSA

#undef  HAVE_ECC
#define HAVE_ECC

#undef  TFM_ECC256
#define TFM_ECC256

#undef  WOLFSSL_BASE64_ENCODE
#define WOLFSSL_BASE64_ENCODE

#undef  NO_RC4
#define NO_RC4

#undef  WOLFSSL_SHA224
#define WOLFSSL_SHA224

#undef  WOLFSSL_SHA3
/* #define WOLFSSL_SHA3 */

#undef  HAVE_POLY1305
#define HAVE_POLY1305

#undef  HAVE_ONE_TIME_AUTH
#define HAVE_ONE_TIME_AUTH

#undef  HAVE_CHACHA
#define HAVE_CHACHA

#undef  HAVE_HASHDRBG
#define HAVE_HASHDRBG

#undef  HAVE_TLS_EXTENSIONS
#define HAVE_TLS_EXTENSIONS

#undef  HAVE_SUPPORTED_CURVES
#define HAVE_SUPPORTED_CURVES

#undef  HAVE_EXTENDED_MASTER
#define HAVE_EXTENDED_MASTER

#undef  NO_PSK
#define NO_PSK

#undef  NO_MD4
#define NO_MD4

#undef  NO_PWDBASED
#define NO_PWDBASED

#undef  USE_FAST_MATH
#define USE_FAST_MATH

#undef  WOLFSSL_NO_ASM
#define WOLFSSL_NO_ASM

#undef  WOLFSSL_X86_BUILD
#define WOLFSSL_X86_BUILD

#undef  WC_NO_ASYNC_THREADING
#define WC_NO_ASYNC_THREADING

#undef  NO_DES3
#define NO_DES3

#undef  WOLFSSL_STATIC_MEMORY
#define WOLFSSL_STATIC_MEMORY

#undef  WOLFSSL_TLS13
#define WOLFSSL_TLS13

#undef  HAVE_HKDF
#define HAVE_HKDF

#undef  WC_RSA_PSS
#define WC_RSA_PSS

#undef  HAVE_FFDHE_2048
#define HAVE_FFDHE_2048

#undef NO_FILESYSTEM
#define NO_FILESYSTEM

#undef WOLFSSL_SMALL_STACK
#define WOLFSSL_SMALL_STACK

#undef WOLFSSH_SCP
#define WOLFSSH_SCP

#undef NO_APITEST_MAIN_DRIVER
#define NO_APITEST_MAIN_DRIVER

#undef NO_TESTSUITE_MAIN_DRIVER
#define NO_TESTSUITE_MAIN_DRIVER

#undef NO_UNITTEST_MAIN_DRIVER
#define NO_UNITTEST_MAIN_DRIVER

#undef NO_MAIN_DRIVER
#define NO_MAIN_DRIVER

#undef WS_NO_SIGNAL
#define WS_NO_SIGNAL

#undef WS_USE_TEST_BUFFERS
#define WS_USE_TEST_BUFFERS

#undef NO_WOLFSSL_DIR
#define NO_WOLFSSL_DIR

#undef WOLFSSH_NO_NONBLOCKING
#define WOLFSSH_NO_NONBLOCKING

#define DEFAULT_WINDOW_SZ (128 * 128)
#define WOLFSSH_MAX_SFTP_RW 8192

#undef NO_FILESYSTEM
#define NO_FILESYSTEM

#ifdef __cplusplus
}
#endif

#endif /* WOLFSSL_USER_SETTINGS_H */
```

## src/wolfssl_user_settings_nofs.h
```c
/* wolfssl_user_settings.h
 *
 * Copyright (C) 2014-2024 wolfSSL Inc.
 *
 * This file is part of wolfSSH.
 *
 * wolfSSH is free software; you can redistribute it and/or modify
 * it under the terms of the GNU General Public License as published by
 * the Free Software Foundation; either version 3 of the License, or
 * (at your option) any later version.
 *
 * wolfSSH is distributed in the hope that it will be useful,
 * but WITHOUT ANY WARRANTY; without even the implied warranty of
 * MERCHANTABILITY or FITNESS FOR A PARTICULAR PURPOSE.  See the
 * GNU General Public License for more details.
 *
 * You should have received a copy of the GNU General Public License
 * along with wolfSSH.  If not, see <http://www.gnu.org/licenses/>.
 */

#ifndef WOLFSSL_USER_SETTINGS_H
#define WOLFSSL_USER_SETTINGS_H

#ifdef __cplusplus
extern "C" {
#endif

#undef  WOLFSSL_ZEPHYR
#define WOLFSSL_ZEPHYR

#undef  TFM_TIMING_RESISTANT
#define TFM_TIMING_RESISTANT

#undef  ECC_TIMING_RESISTANT
#define ECC_TIMING_RESISTANT

#undef  WC_RSA_BLINDING
#define WC_RSA_BLINDING

#undef  HAVE_AESGCM
#define HAVE_AESGCM

#undef  WOLFSSL_SHA512
#define WOLFSSL_SHA512

#undef  WOLFSSL_SHA384
#define WOLFSSL_SHA384

#undef  NO_DSA
#define NO_DSA

#undef  HAVE_ECC
#define HAVE_ECC

#undef  TFM_ECC256
#define TFM_ECC256

#undef  WOLFSSL_BASE64_ENCODE
#define WOLFSSL_BASE64_ENCODE

#undef  NO_RC4
#define NO_RC4

#undef  WOLFSSL_SHA224
#define WOLFSSL_SHA224

#undef  WOLFSSL_SHA3
#define WOLFSSL_SHA3

#undef  HAVE_POLY1305
#define HAVE_POLY1305

#undef  HAVE_ONE_TIME_AUTH
#define HAVE_ONE_TIME_AUTH

#undef  HAVE_CHACHA
#define HAVE_CHACHA

#undef  HAVE_HASHDRBG
#define HAVE_HASHDRBG

#undef  HAVE_TLS_EXTENSIONS
#define HAVE_TLS_EXTENSIONS

#undef  HAVE_SUPPORTED_CURVES
#define HAVE_SUPPORTED_CURVES

#undef  HAVE_EXTENDED_MASTER
#define HAVE_EXTENDED_MASTER

#undef  NO_PSK
#define NO_PSK

#undef  NO_MD4
#define NO_MD4

#undef  NO_PWDBASED
#define NO_PWDBASED

#undef  USE_FAST_MATH
#define USE_FAST_MATH

#undef  WOLFSSL_NO_ASM
#define WOLFSSL_NO_ASM

#undef  WOLFSSL_X86_BUILD
#define WOLFSSL_X86_BUILD

#undef  WC_NO_ASYNC_THREADING
#define WC_NO_ASYNC_THREADING

#undef  NO_DES3
#define NO_DES3

#undef  WOLFSSL_STATIC_MEMORY
#define WOLFSSL_STATIC_MEMORY

#undef  WOLFSSL_TLS13
#define WOLFSSL_TLS13

#undef  HAVE_HKDF
#define HAVE_HKDF

#undef  WC_RSA_PSS
#define WC_RSA_PSS

#undef  HAVE_FFDHE_2048
#define HAVE_FFDHE_2048

#undef NO_FILESYSTEM
#define NO_FILESYSTEM

#undef WOLFSSL_SMALL_STACK
#define WOLFSSL_SMALL_STACK

#ifdef __cplusplus
}
#endif

#endif /* WOLFSSL_USER_SETTINGS_H */
```
